## conf/machine/am62-ksp0728-1-k3r5.conf
```bitbake
#@TYPE: Machine
#@NAME: am62-ksp0728-1-k3r5
#@DESCRIPTION: PHYTEC KSP-0728, 2GiB RAM, HS-FS (R5F)
#@ARTICLENUMBERS: KSP-0728, PCM-071-5432DE11I.A0

require conf/machine/include/phyk3r5.inc

MACHINEOVERRIDES =. "k3r5-am62xx:"
SOC_FAMILY:append = ":k3r5-hs-fs"

SYSFW_SOC = "am62x"
SYSFW_CONFIG = "phycore-som"
SYSFW_SUFFIX = "hs-fs"

UBOOT_MACHINE = "phycore_am62x_r5_defconfig"
```

## conf/machine/am62-ksp0728-1.conf
```bitbake
#@TYPE: Machine
#@NAME: am62-ksp0728-1
#@DESCRIPTION: PHYTEC AM62 PD23.1.0 for  KSP-0728
#@ARTICLENUMBERS: KSP-0728.A0


include conf/machine/include/phyam62xx.inc

MACHINE_FEATURES += "can emmc gpu wifi bluetooth lwb5p tpm2"

KERNEL_DEVICETREE = " \
    ti/k3-am625-ksp0728.dtb \
"

#PREFERRED_RPROVIDER_wpa-supplicant = "summit-supplicant-lwb"
#PREFERRED_RPROVIDER_wpa-supplicant-cli = "summit-supplicant-lwb-cli"
#PREFERRED_RPROVIDER_wpa-supplicant-passphrase = "summit-supplicant-lwb-passphrase"
#PREFERRED_RPROVIDER_wireless-regdb-static = "wireless-regdb"

UBOOT_MACHINE = "phycore_am62x_a53_defconfig"
```

## conf/machine/am62-phyverso-evcs-1.conf
```bitbake
#@TYPE: Machine
#@NAME: am62-phyverso-evcs-1
#@DESCRIPTION: PHYTEC AM62 PD23.1.0 for  KSP-0728
#@ARTICLENUMBERS: PBA-C-35

include conf/machine/include/phyam62xx.inc

MACHINE_FEATURES += "can emmc gpu wifi bluetooth tpm2"

KERNEL_DEVICETREE = " \
    ti/k3-am625-phyverso-evcs-1.dtb \
"

#PREFERRED_RPROVIDER_wpa-supplicant = "summit-supplicant-lwb"
#PREFERRED_RPROVIDER_wpa-supplicant-cli = "summit-supplicant-lwb-cli"
#PREFERRED_RPROVIDER_wpa-supplicant-passphrase = "summit-supplicant-lwb-passphrase"
#PREFERRED_RPROVIDER_wireless-regdb-static = "wireless-regdb"

#IMAGE_BOOT_FILES += "fitImage"
#FITIMAGE_SIGN = "false"
#UBOOT_SIGN_ENABLE = "0"

#BOOTLOADER_SEEK = "0"

EMMC_DEV = "0"

UBOOT_MACHINE = "phycore_am62x_a53_defconfig"

IMAGE_FSTYPES:append:update = " ext4"
# rootfs alignment required for RAUC adaptive update
IMAGE_ROOTFS_ALIGNMENT:update = "4"

# bootloader update is not yet supported
RAUC_BUNDLE_SLOTS:remove:k3 = "bootloader"

UBOOT_MACHINE = "phycore_am62x_a53_defconfig"
WKS_FILE:update = "phyVerso-EVCS-rauc-sdimage.wks"
PARTUP_LAYOUT_CONFIG:update:k3 = "partup-layout-phyverso-evcs-rauc-k3.yaml"
```

## conf/machine/am62-phyverso-evcs.conf
```bitbake
#@TYPE: Machine
#@NAME: am62-phyverso-evcs
#@DESCRIPTION: PHYTEC AM62 PD23.2.1 for  phyVERSO-EVCS
#@ARTICLENUMBERS: PBA-C-35

include conf/machine/include/phyam62xx.inc

MACHINE_FEATURES += "can emmc gpu wifi bluetooth tpm2"

KERNEL_DEVICETREE = " \
    ti/k3-am625-phyverso-evcs.dtb \
"

EMMC_DEV = "0"

UBOOT_MACHINE = "phycore_am62x_a53_defconfig"

IMAGE_FSTYPES:append:update = " ext4"
# rootfs alignment required for RAUC adaptive update
IMAGE_ROOTFS_ALIGNMENT:update = "4"

# bootloader update is not yet supported
RAUC_BUNDLE_SLOTS:remove:k3 = "bootloader"

UBOOT_MACHINE = "phycore_am62x_a53_defconfig"
WKS_FILE:update = "phyVerso-EVCS-rauc-sdimage.wks"
PARTUP_LAYOUT_CONFIG:update:k3 = "partup-layout-phyverso-evcs-rauc-k3.yaml"
```

## scripts/lib/wic/canned-wks/phyVerso-EVCS-rauc-sdimage.wks
```
#part U-BOOT --source rawcopy --sourceparams="file=u-boot.img" --ondisk mmc --no-table --align ${BOOTLOADER_SEEK}
part U-BOOT --source rawcopy --sourceparams="file=u-boot.img" --ondisk mmc --no-table --align 0

include phyVerso-EVCS-rauc-sdimage.wks.inc

bootloader --timeout=0
```
