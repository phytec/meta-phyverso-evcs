## conf/machine/phyverso-evcs-am62xx-1.conf
```bitbake
#@TYPE: Machine
#@NAME: phyverso-evcs-am62xx-1
#@DESCRIPTION: PHYTEC phyVERSO-EVCS AM62x, 2 GB RAM, HS-FS
#@ARTICLENUMBERS: PV-04925-100.A0, KSP-0728-FF.A1, PCM-071-KSM02.A0 (5432DE11I)

include conf/machine/include/phyam62xx.inc

MACHINEOVERRIDES =. ":phyverso-evcs:"

MACHINE_FEATURES += "can emmc gpu wifi bluetooth"

KERNEL_DEVICETREE = " \
    ti/k3-am625-phyverso-evcs.dtb \
    ti/k3-am625-phyverso-evcs-cc3351.dtbo \
    ti/k3-am625-phyverso-evcs-oldi-dd0700mc01-dpi.dtbo \
    ti/k3-am625-phyverso-evcs-oldi-dd0700mc01-lvds.dtbo \
    ti/k3-am625-phyverso-evcs-oldi-ac209a.dtbo \
"

UBOOT_MACHINE = "phycore_am62x_a53_defconfig"
```
